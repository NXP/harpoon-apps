## audio/freertos/Kconfig
```kconfig
# Copyright 2025 NXP
#
# SPDX-License-Identifier: BSD-3-Clause

menu "Harpoon Audio App configuration"
config GENAVB_ENABLE
    bool "Enables GenAVB/TSN Stack"
    select RTOS_APPS_AUDIO_GENAVB_ENABLE

config AUD_DISABLE_ENET
    bool "Enables GenAVB/TSN Stack"
    depends on !GENAVB_ENABLE

config GENAVB_USE_AVDECC
    bool "Enables AVDECC for GenAVB/TSN Stack"
    default y if GENAVB_ENABLE

endmenu

rsource "${SdkRootDirPath}/Kconfig.mcuxpresso"
rsource "${SdkRootDirPath}/../../rtos-apps/Kconfig"
rsource "${SdkRootDirPath}/../../rtos-abstraction-layer/freertos/Kconfig"
rsource "${SdkRootDirPath}/../../gen_avb_sdk/Kconfig"
rsource "${SdkRootDirPath}/../../gen_avb_sdk/apps/rtos/aem-manager/Kconfig"
# Include rpmsg-lite middleware manually
rsource "${SdkRootDirPath}/../../rpmsg-lite/Kconfig"
```

## audio/zephyr/boards/mimx8mm_evk_a53_smp.conf
```kconfig
CONFIG_KERNEL_BIN_NAME="audio_smp"
CONFIG_CODEC_WM8524=y

CONFIG_HAS_MCUX_GPT=y
CONFIG_HAS_MCUX_IGPIO=y

CONFIG_NOCACHE_MEMORY=y
CONFIG_HAS_MCUX_ENET=y
CONFIG_PHY_AR8031=y
CONFIG_HAS_MCUX_II2C=y
```

## audio/zephyr/boards/mimx8mp_evk_a53.conf
```kconfig
CONFIG_KERNEL_BIN_NAME="audio"
CONFIG_CODEC_WM8960=y
CONFIG_I2S=y

CONFIG_HAS_MCUX_GPT=y
CONFIG_HAS_MCUX_IGPIO=y

CONFIG_NOCACHE_MEMORY=y
CONFIG_HAS_MCUX_ENET_QOS=y
CONFIG_PHY_RTL8211F=y
```

## audio/zephyr/boards/mimx8mp_evk_a53_smp.conf
```kconfig
CONFIG_KERNEL_BIN_NAME="audio_smp"
CONFIG_CODEC_WM8960=y
CONFIG_I2S=y
CONFIG_HAS_MCUX_II2C=y
```

## audio/zephyr/boards/mimx93_evk_a55.conf
```kconfig
CONFIG_KERNEL_BIN_NAME="audio"
CONFIG_CODEC_WM8962=y
CONFIG_CODEC_CS42448=y
CONFIG_I2S=y
CONFIG_NOCACHE_MEMORY=y
CONFIG_HAS_MCUX_ENET_QOS=y
CONFIG_PHY_RTL8211F=y
CONFIG_HAS_MCUX_TPM=y
CONFIG_HAS_MCUX_LPI2C=y
CONFIG_HAS_MCUX_RGPIO=y
```

## hello_world/freertos/Kconfig
```kconfig
# Copyright 2025 NXP
#
# SPDX-License-Identifier: BSD-3-Clause

rsource "${SdkRootDirPath}/Kconfig.mcuxpresso"
rsource "${SdkRootDirPath}/../../rtos-apps/Kconfig"
rsource "${SdkRootDirPath}/../../rtos-abstraction-layer/freertos/Kconfig"
```

## industrial/freertos/Kconfig
```kconfig
# Copyright 2025 NXP
#
# SPDX-License-Identifier: BSD-3-Clause

menu "Harpoon Industrial App configuration"
config GENAVB_ENABLE
    bool "Enables GenAVB/TSN Stack"
    default y
    select RTOS_APPS_TSN_GENAVB_ENABLE

config MOTOR_CONTROLLER
    bool "Enables Motor Control"
    depends on GENAVB_ENABLE

endmenu

rsource "${SdkRootDirPath}/Kconfig.mcuxpresso"
rsource "${SdkRootDirPath}/../../rtos-apps/Kconfig"
rsource "${SdkRootDirPath}/../../rtos-abstraction-layer/freertos/Kconfig"
rsource "${SdkRootDirPath}/../../gen_avb_sdk/Kconfig"
# Include rpmsg-lite middleware manually
rsource "${SdkRootDirPath}/../../rpmsg-lite/Kconfig"
```

## industrial/freertos/boards/imx95lp4xevk15/Kconfig
```kconfig
# Copyright 2025 NXP
#
# SPDX-License-Identifier: BSD-3-Clause

config MCUX_HW_BOARD_imx95lp4xevk15
    bool
    default y
    imply MCUX_HW_DEVICE_MIMX9596
```

## industrial/freertos/boards/imx95lpd5evk19/Kconfig
```kconfig
# Copyright 2025 NXP
#
# SPDX-License-Identifier: BSD-3-Clause

config MCUX_HW_BOARD_imx95lpd5evk19
    bool
    default y
    imply MCUX_HW_DEVICE_MIMX9596
```

## industrial/zephyr/boards/imx8mm_evk_mimx8mm6_a53.conf
```kconfig
CONFIG_HAS_MCUX_ENET=y
CONFIG_PHY_AR8031=y
CONFIG_COUNTER_MCUX_GPT=y
CONFIG_HAS_MCUX_GPT=y
```

## industrial/zephyr/boards/imx8mp_evk_mimx8ml8_a53.conf
```kconfig
CONFIG_HAS_MCUX_IGPIO=y
CONFIG_HAS_MCUX_ENET_QOS=y
CONFIG_HAS_MCUX_FLEXCAN=y
CONFIG_PHY_RTL8211F=y
CONFIG_COUNTER_MCUX_GPT=y
CONFIG_HAS_MCUX_GPT=y
```

## industrial/zephyr/boards/imx93_evk_mimx9352_a55.conf
```kconfig
CONFIG_HAS_MCUX_ENET_QOS=y
CONFIG_HAS_MCUX_FLEXCAN=y
CONFIG_PHY_RTL8211F=y
# Enable Zephyr's TPM Counter driver
CONFIG_COUNTER_MCUX_TPM=y
```

## industrial/zephyr/boards/imx95_evk_15x15_mimx9596_a55.conf
```kconfig
CONFIG_HAS_MCUX_FLEXCAN=y
CONFIG_COUNTER_MCUX_TPM=y
CONFIG_HAS_MCUX_TPM=y
CONFIG_PINCTRL_DYNAMIC=y
```

## industrial/zephyr/boards/imx95lp4xevk15/dts/bindings/nxp,harpoon-hal-device.yaml
```yaml
# Copyright 2025 NXP
# SPDX-License-Identifier: BSD-3-Clause

description: |
  NXP Generic Device with Clock and PIN Control definition

  Example:
    flexcan2: flexcan@425b0000 {
      compatible = "nxp,harpoon-hal-device";
      reg = <0x425b0000 DT_SIZE_K(64)>;
      clocks = <&scmi_clk IMX95_CLK_CAN2>;
      pinctrl-0 = <&flexcan2_default>;
      pinctrl-names = "default";
      status = "okay";
    };

compatible: "nxp,harpoon-hal-device"

include: ["base.yaml", "pinctrl-device.yaml"]

properties:
  reg:
    required: true

  pinctrl-0:
    required: false

  clocks:
    required: false
```

## industrial/zephyr/boards/imx95lpd5evk19/dts/bindings/nxp,imx-flexcan.yaml
```yaml
# Copyright 2025 NXP
# SPDX-License-Identifier: Apache-2.0

description: |
  NXP i.MX FlexCAN controller

  Example:
    flexcan2: flexcan@425b0000 {
      compatible = "nxp,imx-flexcan";
      reg = <0x425b0000 DT_SIZE_K(64)>;
      clocks = <&scmi_clk IMX95_CLK_CAN2>;
      pinctrl-0 = <&flexcan2_default>;
      pinctrl-names = "default";
      status = "okay";
    };

compatible: "nxp,imx-flexcan"

include: ["base.yaml", "pinctrl-device.yaml"]

properties:
  reg:
    required: true

  pinctrl-0:
    required: true

  clocks:
    required: true
```

## rt_latency/freertos/Kconfig
```kconfig
rsource "${SdkRootDirPath}/Kconfig.mcuxpresso"
rsource "${SdkRootDirPath}/../../rtos-apps/Kconfig"
rsource "${SdkRootDirPath}/../../rtos-abstraction-layer/freertos/Kconfig"
# Include rpmsg-lite middleware manually
rsource "${SdkRootDirPath}/../../rpmsg-lite/Kconfig"
```

## rt_latency/freertos/boards/imx943evk/Kconfig
```kconfig
# Copyright 2025 NXP
#
# SPDX-License-Identifier: BSD-3-Clause

config MCUX_HW_BOARD_imx943evk
    bool
    default y
    imply MCUX_HW_DEVICE_MIMX94398
```
