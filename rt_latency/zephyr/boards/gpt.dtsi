/*
 * Copyright 2022-2023, 2025 NXP
 *
 * SPDX-License-Identifier: BSD-3-Clause
 */

#define IRQ_HIGHEST_PRIORITY	0

/ {
	aliases {
		counter0 = &gpt1;
		counter1 = &gpt2;
	};
};

&gpt1 {
	interrupts = <GIC_SPI 55 IRQ_TYPE_LEVEL
		IRQ_HIGHEST_PRIORITY>;
	status = "okay";
};

&gpt2 {
	status = "okay";
};
