## rt_latency/zephyr/testcase2/testcase.yaml
```yaml
tests:
  benchmark.kernel.rt-latency:
    build_only: true
    tags: kernel latency
```

## rt_latency/zephyr/testcase7/boards/mimx8mp_evk_a53.conf
```kconfig
CONFIG_COUNTER=y
CONFIG_COUNTER_MCUX_GPT=y
CONFIG_SRAM_BASE_ADDRESS=0x900000
CONFIG_SRAM_SIZE=576
```

## virtio_net/freertos/Kconfig
```kconfig
rsource "${SdkRootDirPath}/Kconfig.mcuxpresso"
rsource "${SdkRootDirPath}/../../rtos-apps/Kconfig"
rsource "${SdkRootDirPath}/../../rtos-abstraction-layer/freertos/Kconfig"
```

## west.yml
```yaml
# The west manifest file for Harpoon Applications

manifest:
  defaults:
    remote: nxp

  remotes:
    - name: nxpzephyr
      url-base: https://github.com/nxp-zephyr
    - name: nxprealtimeedgesw
      url-base: https://github.com/nxp-real-time-edge-sw
    - name: nxpmcuxpresso
      url-base: https://github.com/nxp-mcuxpresso
    - name: nxp
      url-base: https://github.com/NXP

  projects:
    - name: mcuxsdk-manifests
      remote: nxpmcuxpresso
      revision: 664eba64531a0115122747ce615b92c2798352a8
      import:
        path-prefix: mcuxsdk
        name-allowlist:
          - CMSIS
          - core
          - freertos-kernel
          - mcu-sdk-components
          - mcu-sdk-examples
          - mcux-devices-imx

    - name: zephyr
      remote: nxpzephyr
      west-commands: scripts/west-commands.yml
      revision: efe550bc592742561c171381b5c3a1c9b2e2630b
      path: zsdk/zephyr

    - name: hal_nxp
      remote: nxpzephyr
      revision: df59b170b903256d08c57054a6d43b0592d4d692
      path: zsdk/modules/hal/nxp

    # mcux-sdk-ng Kconfig in hal_nxp requires Kconfig symbols from els_pkc and psa_crypto_driver
    - name: els_pkc
      remote: nxp
      repo-path: els_pkc
      revision: 71d4a89c03fb32e618ee02c0cd54b3fc92736c96
      path: zsdk/modules/crypto/els_pkc
    - name: psa_crypto_driver
      remote: nxp
      repo-path: psa_crypto_driver
      revision: 1a93893f986db38cf2c8910f6138b634f0437a48
      path: zsdk/modules/crypto/psa_crypto_driver

    - name: GenAVB_TSN
      remote: nxp
      revision: 851c0cae1353ee4b45d755d52b6a73b7b507e32b
      path: gen_avb_sdk
    - name: rtos-abstraction-layer
      remote: nxp
      revision: a72719986c8d2d4482258bafebb4e61d72e66ae0
    - name: rtos-apps
      remote: nxp
      revision: 090c2169573744d195e1e7bdf3aebfdc58e80407
    - name: heterogeneous-multicore
      remote: nxprealtimeedgesw
      revision: 54dfae8caf7b928eddea54a9bc042b77d11b6ce0
    - name: rpmsg-lite
      remote: nxpmcuxpresso
      revision: 42a37572d84fbabb35455292b3a87244b10a877e

  self:
    path: harpoon-apps
```
